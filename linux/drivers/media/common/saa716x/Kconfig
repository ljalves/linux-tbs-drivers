## linux/drivers/media/common/saa716x/Kconfig
```kconfig
menuconfig SAA716X_SUPPORT
	bool "Support for SAA716x family from NXP/Philips"
	depends on PCI && I2C
	help
	  support for saa716x

if SAA716X_SUPPORT
config SAA716X_CORE
	tristate "SAA7160/1/2 PCI Express bridge based devices"
	depends on PCI && I2C

	help
	  Support for PCI cards based on the SAA7160/1/2 PCI Express bridge.

	  Say Y if you own such a device and want to use it.

config DVB_SAA716X_TBS
	tristate "SAA7160 based TBS PCIe cards (DVB only)"
	depends on SAA716X_CORE && DVB_CORE

	help
	  Support for the SAA7160 based TBS PCIe DVB cards

	  Say Y if you own such a device and want to use it.

endif # SAA716X_SUPPORT
```
